#ifndef config_hdmi
#define config_hdmi

#define TFP401_ST 5 //@Output drive strength select
#define TFP401_PD 7 //@Power down
#define TFP401_PDO 8 //@Output drive power down
#define TFP401_SCDT 12
#define CT_HPD A4 //@ HIGH = Enable Load Switch(5V Out) and HPD_B
#define DET_HPD A5

void hpd_init()
{
  pinMode(CT_HPD, OUTPUT);
  pinMode(DET_HPD, INPUT);
  delay(10);
}

void hpd_on()
{
  digitalWrite(CT_HPD, HIGH);
}
void hpd_off()
{
  digitalWrite(CT_HPD, LOW);
}

boolean get_hpd()
{
  return digitalRead(DET_HPD);
}

boolean scdt_get()
{
  return digitalRead(TFP401_SCDT);
}
boolean hpd_get()
{
  return digitalRead(DET_HPD);
}

void tfp401_on()
{
  digitalWrite(TFP401_PD, HIGH);
  digitalWrite(TFP401_PDO, HIGH);
}

void tfp401_off()
{
  digitalWrite(TFP401_PD, LOW);
  digitalWrite(TFP401_PDO, LOW);
}

void tfp401_init()
{
  pinMode(TFP401_PD, OUTPUT);
  pinMode(TFP401_PDO, OUTPUT);
  pinMode(TFP401_SCDT, INPUT);
  digitalWrite(TFP401_SCDT, LOW);
  
  pinMode(TFP401_ST, OUTPUT);
  //digitalWrite(TFP401_ST, HIGH);
  digitalWrite(TFP401_ST, LOW);
  
  tfp401_off();
}

#define EEPROM_WP 11   //@ LOW = Write Enabled | HIGH = Write Disabled
#define EEPROM_ADDR 0x50

char EDID[] = {
0x00, 0xFF, 0xFF, 0xFF, 0xFF, 0xFF, 0xFF, 0x00, 0x24, 0x27, 0x01, 0x00, 0x01, 0x00, 0x00, 0x00,
0x2C, 0x18, 0x01, 0x03, 0x81, 0x0A, 0x06, 0x78, 0xE7, 0x00, 0x00, 0xA2, 0x57, 0x4B, 0x97, 0x24, 
0x18, 0x4F, 0x53, 0x00, 0x00, 0x00, 0x01, 0x01, 0x01, 0x01, 0x01, 0x01, 0x01, 0x01, 0x01, 0x01, 
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0x00, 0x00, 0x00, 0x00, 0x00, 0x00, 0x00, 0x00, 0x00, 0x00, 0x00, 0x00, 0x00, 0x00, 0x00, 0x00
};

void edid_init()
{
  pinMode(EEPROM_WP, OUTPUT);
}

void edid_wp(boolean on)
{
  if (on)
  {
    digitalWrite(EEPROM_WP, HIGH);
  } else {
    digitalWrite(EEPROM_WP, LOW);
  }
}

void edidWrite(char * array)
{
  delay(10);
  for(byte i =0; i < 128;i++)
  {
    Wire.beginTransmission(EEPROM_ADDR);
    Wire.write(i);
    Wire.write(array[i]);
    Wire.endTransmission();
    delay(5);
  }  
}

int edidRead(char * array)
{
  byte mycount = 0; 
  Wire.beginTransmission(EEPROM_ADDR);
  Wire.write(mycount);
  Wire.endTransmission();
  for(int j =0; j < 128; j++){
  Wire.requestFrom(EEPROM_ADDR, 1);
  if (Wire.available())    // slave may send less than requested
  { 
    array[j] = Wire.read(); // receive a byte as character
    mycount++;
  }
    delay(10);
  }
  return mycount; 
}

#endif




